// SPDX-License-Identifier: GPL-2.0+
/*
 * Copyright (C) 2021 DH electronics GmbH
 *
 * DHCOM iMX6 variant:
 * DHCM-iMX6Q-C0800-R102-F0819-E-SD-RTC-T-HS-I-01D2
 * DHCOM PCB number: 493-300 or newer
 * PicoITX PCB number: 487-600 or newer
 */
/dts-v1/;

#include "imx6q.dtsi"
#include "imx6qdl-dhcom-som.dtsi"
#include "imx6qdl-dhcom-dhmi-10inch.dtsi"

/ {
	model = "DH electronics i.MX6Q DHCOM on DHMI 10inch";
	compatible = "dh,imx6q-dhcom-dhmi10inch", "dh,imx6q-dhcom-som",
		     "fsl,imx6q";
};
