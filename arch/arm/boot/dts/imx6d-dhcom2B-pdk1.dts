/*
 * Copyright 2015 DH electronics GmbH
 *
 * This program is free software; you can redistribute it and/or modify
 * it under the terms of the GNU General Public License version 2 as
 * published by the Free Software Foundation.
 */

/dts-v1/;

//******************************************************************************
// C P U - T Y P E
//******************************************************************************
#include "imx6d.dtsi"
#define IMX6_CPU_DUAL_QUAD // Used to distinguish the CPU types


//******************************************************************************
// D H C O M - M O D U L E
//******************************************************************************

// Basic configuration
//**********************************************************
// HW200 base
#include "imx6qdl-dhcom2B.dtsi"

// Memory 1GB DDR3 RAM
/ {
	memory {
		reg = <0x10000000 0x40000000>;
	};
};

// Special configurations
//**********************************************************
// Enables NAND, disables eMMC
//#include "imx6qdl-dhcom_cfg-nand.dtsi"

// Enable RS485 for UART2 (ttymxc4)
//#include "imx6qdl-dhcom_cfg-rs485.dtsi"

// Eenables WEIM example config with UIO-Driver
//#include "imx6qdl-dhcom_cfg-weim.dtsi"


//******************************************************************************
// B O A R D - C O N F I G U R A T I O N
//******************************************************************************
#include "imx6qdl-dh_pdk1.dtsi"


/ {
	model = "Freescale i.MX6 Dual DHCOM Premium Developer Kit (1)";
	compatible = "fsl,imx6d-dhcom2B-pdk1", "fsl,imx6q"; // It is a Quad with only 2 CPUs
};
