// SPDX-License-Identifier: GPL-2.0+
/*
 * Copyright (C) 2023 DH electronics GmbH
 *
 * DHCOM iMX6 variant:
 * DHCM-iMX6DL-C0800-R102-F0819-E-SD-RTC-T-HS-I-01D2
 * DHCOM PCB number: 493-300 or newer
 * EP-1109G PCB
 */
/dts-v1/;

#include "imx6dl.dtsi"
#include "imx6qdl-dhcom-som.dtsi"
#include "imx6qdl-dhcom-ep-1109g.dtsi"

/ {
	model = "DH electronics i.MX6DL DHCOM on EP-1109G";
	compatible = "dh,imx6dl-dhcom-ep-1109g", "dh,imx6dl-dhcom-som",
		     "fsl,imx6dl";
};
