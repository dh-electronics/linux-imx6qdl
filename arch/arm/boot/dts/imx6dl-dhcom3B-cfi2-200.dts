/*
 * Copyright 2015 DH electronics GmbH
 *
 * This program is free software; you can redistribute it and/or modify
 * it under the terms of the GNU General Public License version 2 as
 * published by the Free Software Foundation.
 */

/dts-v1/;

//******************************************************************************
// C P U - T Y P E
//******************************************************************************
#include "imx6dl.dtsi"
#define IMX6_CPU_SOLO_DUALLITE // Used to distinguish the CPU types


//******************************************************************************
// D H C O M - M O D U L E
//******************************************************************************

// Basic configuration
//**********************************************************
// HW300 base
#include "imx6qdl-dhcom3B.dtsi"

// Memory 1GB DDR3 RAM
/ {
	memory {
		reg = <0x10000000 0x40000000>;
	};
};

// Special configurations
//**********************************************************
// Enables NAND, disables eMMC
//#include "imx6qdl-dhcom_cfg-nand.dtsi"


//******************************************************************************
// B O A R D - C O N F I G U R A T I O N
//******************************************************************************
#include "imx6qdl-dh_cfi2-200.dtsi"


/ {
	model = "Freescale i.MX6 DualLite DHCOM CFI2-200";
	compatible = "fsl,imx6dl-dhcom3B-cfi2-200", "fsl,imx6dl";
};
