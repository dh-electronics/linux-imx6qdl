/*
 * Copyright 2016 DH electronics GmbH
 *
 * This program is free software; you can redistribute it and/or modify
 * it under the terms of the GNU General Public License version 2 as
 * published by the Free Software Foundation.
 */

/dts-v1/;

//******************************************************************************
// C P U - T Y P E
//******************************************************************************
#include "imx6d.dtsi"
#define IMX6_CPU_DUAL_QUAD // Used to distinguish the CPU types


//******************************************************************************
// D H C O M - M O D U L E
//******************************************************************************

// Basic configuration
//**********************************************************
// HW300 base
#include "imx6qdl-dhcom3B.dtsi"

// Special configurations
//**********************************************************
// Enables NAND, disables eMMC
//#include "imx6qdl-dhcom_cfg-nand.dtsi"


//******************************************************************************
// B O A R D - C O N F I G U R A T I O N
//******************************************************************************
#include "imx6qdl-dh_drc01.dtsi"

/ {
	model = "Freescale i.MX6 Dual DHCOM DRC01";
	compatible = "fsl,imx6d-dhcom3B-drc01", "fsl,imx6q"; // It is a Quad with only 2 CPUs
};
